## config/west.yml
```yaml
manifest:
  remotes:
    - name: zmkfirmware
      url-base: https://github.com/mlx3im
  projects:
    - name: zmk
      remote: zmkfirmware
      revision: totp
      import: app/west.yml
  self:
    path: config
```
